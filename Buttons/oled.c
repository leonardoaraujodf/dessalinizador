#include "oled.h"

const unsigned char init_cmd_array[] = {

    OLED_CONTROL_BYTE_CMD_STREAM,

    // Follow instructions on pg.64 of the dataSheet for software configuration of the SSD1306
    // Turn the Display OFF
    OLED_CMD_DISPLAY_OFF,
    // Set mux ration tp select max number of rows - 64
    OLED_CMD_SET_MUX_RATIO,
    0x3F,
    // Set the display offset to 0
    OLED_CMD_SET_DISPLAY_OFFSET,
    0x00,
    // Display start line to 0
    OLED_CMD_SET_DISPLAY_START_LINE,

    // Mirror the x-axis. In case you set it up such that the pins are north.
    // Wire.write(0xA0); - in case pins are south - default
    OLED_CMD_SET_SEGMENT_REMAP,

    // Mirror the y-axis. In case you set it up such that the pins are north.
    // Wire.write(0xC0); - in case pins are south - default
    OLED_CMD_SET_COM_SCAN_MODE,

    // Default - alternate COM pin map
    OLED_CMD_SET_COM_PIN_MAP,
    0x12,
    // set contrast
    OLED_CMD_SET_CONTRAST,
    0x7F,
    // Set display to enable rendering from GDDRAM (Graphic Display Data RAM)
    OLED_CMD_DISPLAY_RAM,
    // Normal mode!
    OLED_CMD_DISPLAY_NORMAL,
    // Default oscillator clock
    OLED_CMD_SET_DISPLAY_CLK_DIV,
    0x80,
    // Enable the charge pump
    OLED_CMD_SET_CHARGE_PUMP,
    0x14,
    // Set precharge cycles to high cap type
    OLED_CMD_SET_PRECHARGE,
    0x22,
    // Set the V_COMH deselect volatage to max
    OLED_CMD_SET_VCOMH_DESELCT,
    0x30,
    // Horizonatal addressing mode - same as the KS108 GLCD
    OLED_CMD_SET_MEMORY_ADDR_MODE,
    0x00,
    // Turn the Display ON
    OLED_CMD_DISPLAY_ON
};

const unsigned char WriteInit[] =
{
     OLED_CONTROL_BYTE_CMD_STREAM,
     OLED_CMD_SET_COLUMN_RANGE,
     0x00,
     0x7F,
     OLED_CMD_SET_PAGE_RANGE,
     0x00,
     0x07
};

const unsigned char bat_20 [] = {OLED_CONTROL_BYTE_DATA_STREAM,
0x00, 0x00, 0x00, 0x00, 0x00, 0x00, 0x00, 0xC0, 0xC0, 0xC0, 0xC0, 0xC0, 0xC0, 0xC0, 0xC0, 0xC0,
0xC0, 0xC0, 0xC0, 0xC0, 0xC0, 0xC0, 0xC0, 0xC0, 0xC0, 0xC0, 0xC0, 0xC0, 0xC0, 0xC0, 0xC0, 0xC0,
0xC0, 0xC0, 0xC0, 0xC0, 0xC0, 0xC0, 0xC0, 0xC0, 0xC0, 0xC0, 0xC0, 0xC0, 0xC0, 0xC0, 0xC0, 0xC0,
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0x00, 0x00, 0x00, 0x00, 0x00, 0x00, 0x00, 0x00, 0x00, 0x00, 0x00, 0x00, 0x00, 0x00, 0x00, 0x00
};

const unsigned char bat_40 [] = {OLED_CONTROL_BYTE_DATA_STREAM,
0x00, 0x00, 0x00, 0x00, 0x00, 0x00, 0x00, 0x00, 0x00, 0x00, 0x00, 0x00, 0x00, 0x00, 0x00, 0x00,
0x00, 0x00, 0x00, 0x00, 0x00, 0x00, 0x00, 0x00, 0x00, 0x00, 0x00, 0x00, 0x00, 0x00, 0x00, 0x00,
0x00, 0x00, 0x00, 0x00, 0x00, 0x00, 0x00, 0x00, 0x00, 0x00, 0x00, 0x00, 0x00, 0x00, 0x00, 0x00,
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0x00, 0x00, 0x00, 0x00, 0x00, 0x00, 0x00, 0x00, 0x00, 0x00, 0x00, 0x00, 0x00, 0x00, 0x00, 0x00
};

const unsigned char bat_60 [] = {OLED_CONTROL_BYTE_DATA_STREAM,
0x00, 0x00, 0x00, 0x00, 0x00, 0x00, 0x00, 0x00, 0x00, 0x00, 0x00, 0x00, 0x00, 0x00, 0x00, 0x00,
0x00, 0x00, 0x00, 0x00, 0x00, 0x00, 0x00, 0x00, 0x00, 0x00, 0x00, 0x00, 0x00, 0x00, 0x00, 0x00,
0x00, 0x00, 0x00, 0x00, 0x00, 0x00, 0x00, 0x00, 0x00, 0x00, 0x00, 0x00, 0x00, 0x00, 0x00, 0x00,
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0x00, 0x00, 0x00, 0x00, 0x00, 0x00, 0x00, 0x00, 0x00, 0x00, 0x00, 0x00, 0x00, 0x00, 0x00, 0x00
};

const unsigned char bat_80 [] = {OLED_CONTROL_BYTE_DATA_STREAM,
0x00, 0x00, 0x00, 0x00, 0x00, 0x00, 0x00, 0x00, 0x00, 0x00, 0x00, 0x00, 0x00, 0x00, 0x00, 0x00,
0x00, 0x00, 0x00, 0x00, 0x00, 0x00, 0x00, 0x00, 0x00, 0x00, 0x00, 0x00, 0x00, 0x00, 0x00, 0x00,
0x00, 0x00, 0x00, 0x00, 0x00, 0x00, 0x00, 0x00, 0x00, 0x00, 0x00, 0x00, 0x00, 0x00, 0x00, 0x00,
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0x00, 0x00, 0x00, 0x00, 0x00, 0x00, 0x00, 0x00, 0x00, 0x00, 0x00, 0x00, 0x00, 0x00, 0x00, 0x00
};

const unsigned char bat_100 [] = {OLED_CONTROL_BYTE_DATA_STREAM,
0x00, 0x00, 0x00, 0x00, 0x00, 0x00, 0x00, 0x00, 0x00, 0x00, 0x00, 0x00, 0x00, 0x00, 0x00, 0x00,
0x00, 0x00, 0x00, 0x00, 0x00, 0x00, 0x00, 0x00, 0x00, 0x00, 0x00, 0x00, 0x00, 0x00, 0x00, 0x00,
0x00, 0x00, 0x00, 0x00, 0x00, 0x00, 0x00, 0x00, 0x00, 0x00, 0x00, 0x00, 0x00, 0x00, 0x00, 0x00,
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0x00, 0x00, 0x00, 0x00, 0x00, 0x00, 0x00, 0x00, 0x00, 0x00, 0x00, 0x00, 0x00, 0x00, 0x00, 0x00
};

const unsigned char SendData = {OLED_CONTROL_BYTE_DATA_STREAM};


void WriteCmdOLED(const unsigned char* data, unsigned char size){
    int data_sent;
    OpenTransmission(OLED_I2C_ADDRESS);
   	data_sent = write(i2c_fd,data,size);
    if(data_sent < size){
        printf("[ERROR] Error trying to send an I2C command.\n");
    }
    CloseTransmission();
}

void WriteDataOLED(const unsigned char* data, unsigned int size){
	int data_sent;
	WriteCmdOLED(WriteInit,sizeof(WriteInit));

    /*command for sending data*/
        OpenTransmission(OLED_I2C_ADDRESS);

        data_sent = write(i2c_fd,data,size);
        if(data_sent < size){
					printf("[ERROR] Error trying to send an I2C data.\n");
				}

        CloseTransmission();
    /*command for sending data*/

}

void OLEDInit(){
    WriteCmdOLED(init_cmd_array, sizeof(init_cmd_array));
}

void OpenTransmission(int address){
	i2c_fd = open("/dev/i2c-1", O_RDWR);
	if(i2c_fd < 0){
		printf("[ERROR] Error opening an I2C file.\n");
	}
	if(ioctl(i2c_fd, I2C_SLAVE,address) < 0){
		printf("[ERROR] Error at IOCTL (I2C file).\n");
	}
}

void CloseTransmission(){
	close(i2c_fd);
}

void get_Battlevel(int *values){

	qsort(values,30,sizeof(int),compare);
	float level = get_median(values);

  if(level < 865){
    printf("[LOG] Battery level under 20 %\n");
    //WriteDataOLED(josy,sizeof(josy));
    WriteDataOLED(bat_20,sizeof(bat_20));
    turn_Component(TURN_BOMB_OFF);
  }
  else{
    if(level > 865 && level < 884){
      printf("[LOG] Battery level: 40 %\n");
      WriteDataOLED(bat_40,sizeof(bat_40));
    }
    else if(level > 884 && level < 902){
      printf("[LOG] Battery level: 60 %\n");
      WriteDataOLED(bat_60,sizeof(bat_60));
    }
    else if(level > 902 && level < 920){
      printf("[LOG] Battery level: 80 %\n");
      WriteDataOLED(bat_80,sizeof(bat_80));
    }
    else if(level > 920){
      printf("[LOG] Battery level: 100 %\n");
      WriteDataOLED(bat_100,sizeof(bat_100));
    }
    sleep(1);
    turn_Component(TURN_BOMB_ON);
    sleep(1);
    turn_Component(LOW_VALVE_CLOSE);
    sleep(1);
    turn_Component(TOP_VALVE_OPEN);
    sleep(2);
    turn_Component(SAMPLES_MOTOR_ON);
    sleep(2);
  }
}

float get_Temp(void){
	int fp,length = 0,i_temp;
	float temp;
	char c,*text;
	fp = open(TEMP_PATH, O_RDONLY);
	if(fp==-1){
		printf("[ERROR] Error opening temperature sensor file.\n");
    GPIO_close(ON_GPIO_fd);
  	GPIO_close(OFF_GPIO_fd);
  	GPIO_free(ON_BTN);
  	GPIO_free(OFF_BTN);
		exit(1);
	}
	while(read(fp, &c, 1) != 0){
		length++;
	}

	text = (char *)calloc(length,sizeof(char));
	lseek(fp, 0, SEEK_SET);
	read(fp,text,length);
	i_temp = atoi(&text[length-6]);
	temp = i_temp/1000.0;
	//printf("Temperature: %.3f C\n",temp);
	close(fp);
	return temp;
}

float get_TDS(int *values){
	qsort(values,30,sizeof(int),compare);
	float AD_value, voltage, TDS_value;
	AD_value = get_median(values);
	voltage = (3.3/1024)*AD_value;
	TDS_value = (133.42*voltage*voltage*voltage - 255.86*voltage*voltage + 857.39*voltage)*0.5;
	return TDS_value;
}

float get_Turb(int *values){
	qsort(values,30,sizeof(int),compare);
	float AD_value, voltage, Turbidity_value;
	AD_value = get_median(values);
	voltage = (3.3/1024)*AD_value;
	Turbidity_value = -1120.4*voltage*voltage+5742.3*voltage-4352.9;
	return Turbidity_value;
}

float get_PH(int *values){
	qsort(values,30,sizeof(int),compare);
	float AD_value, voltage, PH_value;
	AD_value = get_median(values);
	voltage = (2)*(3.3/1024)*(AD_value);
	PH_value = -5.70*voltage+21.34;
	return PH_value;
}

int get_localization(char *gps_data){

//returns 0 if success
//returns -1 if a error occurred

	int uart0_fd;
	char character,sentence[6] = {0};
	int i,out = 0;

	uart0_fd = serialOpen(TTY, 9600);

	if(uart0_fd == -1){
		puts("Error trying to open UART.");
		return -1;
	}

	if(wiringPiSetup() == -1){
		puts("Error in wiringPiSetup().");
		return -1;
	}

	serialFlush(uart0_fd);
	system("stty -F " TTY " 9600");
	system("stty -F " TTY " -echo");
	//system("stty -F " TTY);
	while(out == 0){
		character = serialGetchar(uart0_fd);
		//printf("%c",character);
		if(character == '$'){
			for(i=0; i<5; i++){
				sentence[i] = serialGetchar(uart0_fd);
			}
			if(strcmp(sentence,"GPGGA") == 0){
				sprintf(gps_data,"%c%s",character,sentence);
				i = 0;
				do{
					character = serialGetchar(uart0_fd);
					gps_data[i + 6] = character;
					i++;

				}while(character != '\n');

				//printf("%s",gps_data);
				//printf("\n");
				break;
				}
			}
	}

	//puts("Fechando " TTY "...");
	serialClose(uart0_fd);
	return 0;
}

int compare (const void * a, const void * b){
  return ( *(int*)a - *(int*)b );
}

float get_median(int *values){
	return ((values[14] + values[15])/2.0) ;
}

void split_by(char *token, char *string, char array[MAX_NUMBER_OF_FIELDS][MAX_STRING_LENGTH])
{
	char *raw_string = string;
	char *raw_string_info = NULL;

	int i;
	for (i = 0, raw_string_info = strsep(&raw_string, ","); raw_string_info != NULL; i++, raw_string_info = strsep(&raw_string, ","))
	{
		strcpy(array[i], raw_string_info);
	}
}

double convert_dms_cordinate_to_decimal(double dms_coordinate)
{
	int degrees = dms_coordinate / 100;
	double minutes = dms_coordinate - degrees * 100;
	double decimal_coordinate = degrees + minutes / 60.0;

	return decimal_coordinate;
}

int compute_direction(char *raw_direction)
{
	int direction = (strcmp(raw_direction, "W") == 0) || (strcmp(raw_direction, "S") == 0) ? -1 : 1;

	return direction;
}

void format_coordinate(char coordinate, char gps_info[MAX_NUMBER_OF_FIELDS][MAX_STRING_LENGTH], char coordinates[2][MAX_STRING_LENGTH])
{
	int COORDINATE_INDEX = 0;
	int COORDINATE_DIRECTION_INDEX = 0;
	int COORDINATE = 0;

	if (coordinate == 'X')
	{
		COORDINATE_INDEX = LATITUDE_INDEX;
		COORDINATE_DIRECTION_INDEX = HORIZONTAL_DIRECTION_INDEX;
		COORDINATE = X;
	}
	else
	{
		COORDINATE_INDEX = LONGITUDE_INDEX;
		COORDINATE_DIRECTION_INDEX = VERTICAL_DIRECTION_INDEX;
		COORDINATE = Y;
	}

	double dms_coordinate = strtod(gps_info[COORDINATE_INDEX], NULL);
	double decimal_coordinate = convert_dms_cordinate_to_decimal(dms_coordinate);
	double coordinate_with_direction = decimal_coordinate * compute_direction(gps_info[COORDINATE_DIRECTION_INDEX]);
	char formated_coordinate[50] = {0};

	snprintf(coordinates[COORDINATE], 50, "%lf", coordinate_with_direction);
}

void format_coordinates(char gps_info[MAX_NUMBER_OF_FIELDS][MAX_STRING_LENGTH], char coordinates[2][MAX_STRING_LENGTH])
{
	format_coordinate('X', gps_info, coordinates);
	format_coordinate('Y', gps_info, coordinates);
}

void get_collection_date(char *formatted_time)
{
	time_t now = time(NULL);
	struct tm *t = localtime(&now);

	sprintf(formatted_time, "%d-%02d-%02d %02d:%02d:%02d", t->tm_year + 1900, t->tm_mon + 1, t->tm_mday, t->tm_hour, t->tm_min, t->tm_sec);
}

void create_new_sample_file(float turbidity, float ph, float temperature, float tds, char *x_coordinate, char *y_coordinate)
{
	FILE *new_sample = fopen(NEW_SAMPLE_PATH, "w");
	char collection_date[MAX_STRING_LENGTH] = {0};
	if (new_sample == NULL)
	{
		printf("ERROR: New sample file could not be created!\n");
		exit(-1);
	}
	else
	{
		printf("[LOG] Creating new sample file...\n");
	}

	// Writing indicators
	get_collection_date(collection_date);

	fprintf(new_sample, "turbidity: %.2f \n", turbidity);
	fprintf(new_sample, "ph: %.2f\n", ph);
	fprintf(new_sample, "temperature: %.2f\n", temperature);
	fprintf(new_sample, "tds: %.2f\n", tds);
	fprintf(new_sample, "collection_date: %s\n", collection_date);
	fprintf(new_sample, "latitude: %s\n", x_coordinate);
	fprintf(new_sample, "longitude: %s\n", y_coordinate);

	fclose(new_sample);
}

void ctrl_c(int sig){

	int i;
	for(i=0; i < NUMBER_THREADS; i++){
		pthread_cancel(GPIO_tid[i]);
	}

	GPIO_close(ON_GPIO_fd);
	GPIO_close(OFF_GPIO_fd);
	GPIO_free(ON_BTN);
	GPIO_free(OFF_BTN);
	//exit(-1);
}

void *GPIO_handler(void *param){

	int *GPIO_fd_num = (int *) param;
	char my_gpio[10];

	if((*GPIO_fd_num) == ON_GPIO_fd){
		sprintf(my_gpio,"On button");
		while(1){
			if(GPIO_get(*GPIO_fd_num) == 0){
				printf("[LOG] %s pressed.\n",my_gpio);
				get_samples();
			}
			usleep(300000);
		}
	}
	else if((*GPIO_fd_num) == OFF_GPIO_fd){
		sprintf(my_gpio,"Off button");
		while(1){
			if(GPIO_get(*GPIO_fd_num) == 0){
				printf("[LOG] %s pressed.\n",my_gpio);
        sleep(1);
				turn_Component(TURN_BOMB_OFF);
			}
			usleep(300000);
		}
	}
}

void GPIO_setup(int GPIO_num){
//Create a GPIO

	char str[50];
	printf("[LOG] Seeting GPIO %d as a digital input pin.\n", GPIO_num);
	sprintf(str,"echo %d > /sys/class/gpio/export", GPIO_num);
	system(str);
	sprintf(str,"echo in > /sys/class/gpio/gpio%d/direction", GPIO_num);
	system(str);
	printf("[LOG] Configured.\n");

	if(GPIO_num == ON_BTN){
		GPIO_open(ON_GPIO_fd,GPIO_num);
	}
	else if(GPIO_num == OFF_BTN){
		GPIO_open(OFF_GPIO_fd,GPIO_num);
	}
}

void GPIO_free(int GPIO_num){
	int fd;
	char str[2];
	sprintf(str,"%d",GPIO_num);
	fd = open("/sys/class/gpio/unexport", O_WRONLY);
	if(fd == -1){
		printf("[ERROR] Could not release the GPIO %d\n", GPIO_num);
	}
	else{
		write(fd, str, 2);
		close(fd);
		printf("[LOG] GPIO %d released.\n", GPIO_num);
	}
}

void GPIO_open(int GPIO_fd_num,int GPIO_num){
	char str[50];
	sprintf(str,"/sys/class/gpio/gpio%d/value", GPIO_num);
	GPIO_fd[GPIO_fd_num] = open(str, O_RDONLY);
}

void GPIO_close(int GPIO_fd_num){

	close(GPIO_fd[GPIO_fd_num]);
}

int GPIO_get(int GPIO_fd_num){
	int iValue;
	char cValue[1];
	read(GPIO_fd[GPIO_fd_num], cValue, 1);
	lseek(GPIO_fd[GPIO_fd_num],0,SEEK_SET);
	iValue = atoi(cValue);
	return iValue;
}
void get_samples(void){

	struct analog sensors;
	OLEDInit();

  get_MSPsamples(&sensors,GET_MSP_SAMPLES);
  get_Battlevel(sensors.bat_level);
  verify_LevelSensor();
  get_MSPsamples(&sensors,GET_MSP_SAMPLES);

	/*
	for(i=0;i<30;i++){
		printf("Ph sensor: %d\n",sensors.ph_sensor[i]);
		printf("Turbidity sensor: %d\n",sensors.turb_sensor[i]);
		printf("Tds sensor: %d\n",sensors.tds_sensor[i]);
		printf("Battery level: %d\n",sensors.bat_level[i]);
	}
	*/
	char gps_data[100] = {0};
	float PH_value, TDS_value, Turbidity_value, Temp;

	Temp = get_Temp();
	PH_value = get_PH(sensors.ph_sensor);
	TDS_value = get_TDS(sensors.tds_sensor);
	Turbidity_value = get_Turb(sensors.turb_sensor);
	//get_Battlevel(sensors.bat_level);
	get_localization(gps_data);

	char gps_info[MAX_NUMBER_OF_FIELDS][MAX_STRING_LENGTH];
	char coordinates[2][MAX_STRING_LENGTH] = {0};
	char gps_data_copy[100] = {0};

	strcpy(gps_data_copy, gps_data);
	split_by(",", gps_data_copy, gps_info);

	format_coordinates(gps_info, coordinates);

	// printf("**************\n");
	// printf("X raw: %s\n", gps_info[LATITUDE_INDEX]);
	// printf("Y raw: %s\n", gps_info[LONGITUDE_INDEX]);
	// printf("Horizontal direction: %s\n", gps_info[HORIZONTAL_DIRECTION_INDEX]);
	// printf("Vertical direction: %s\n", gps_info[VERTICAL_DIRECTION_INDEX]);
	// printf("X: %s\n", coordinates[X]);
	// printf("Y: %s\n", coordinates[Y]);
	// printf("**************\n");

	create_new_sample_file(Turbidity_value, PH_value, Temp, TDS_value, coordinates[X], coordinates[Y]);
	puts("[LOG] New sample created! Notifying Rasp API.");
	system("curl localhost:8000/new_sample");
  throw_SamplesWaterOff();
}

void verify_LevelSensor(void){
  unsigned char value = DETECT_LEVEL_SENSOR, data_received;
  while(data_received != LEVEL_SENSOR_ON){
    OpenTransmission(MSP430_ADDRESS);
    if(write(i2c_fd,&value,1) < 0){
      printf("[ERROR] Error trying to write in i2c_fd.\n");
    }
    if(read(i2c_fd,&data_received,1) < 0){
      printf("[ERROR] Error trying to read in i2c_fd.\n");
    }
    else{
			srand(time(NULL));
			int i;
			int n = 3 + rand() / (RAND_MAX / (10 - 3 + 1) + 1);

			for (i = 0; i < n; i++)
			{
				printf("[LOG] Waiting water to be in the level...\n");
				sleep(1);
			}
			printf("[LOG] Water is in the level. Taking samples...\n");
		}
    CloseTransmission();
  }
  turn_Component(SAMPLES_MOTOR_OFF);
  sleep(2);
  turn_Component(TOP_VALVE_CLOSE);
}

void get_MSPsamples(struct analog *sensors, unsigned int start_comm){

  int i;
  OpenTransmission(MSP430_ADDRESS);
  for(i=0; i<30; i++){

    if(write(i2c_fd,&start_comm,1) < 0){
      printf("Error trying to write in i2c_fd.\n");
    }

    if(read(i2c_fd,sensors->data,8) < 0){
      printf("Error trying to read in i2c_fd.\n");
    }

    sensors->ph_sensor[i] = sensors->data[0];
    sensors->ph_sensor[i] += sensors->data[1] << 8;

    sensors->turb_sensor[i] = sensors->data[2];
    sensors->turb_sensor[i] += sensors->data[3] << 8;

    sensors->tds_sensor[i] = sensors->data[4];
    sensors->tds_sensor[i] += sensors->data[5] << 8;

    sensors->bat_level[i] = sensors->data[6];
    sensors->bat_level[i] += sensors->data[7] << 8;

  }

  CloseTransmission();
}

void throw_SamplesWaterOff(void){
    sleep(1);
    turn_Component(TOP_VALVE_SLEEP);
    sleep(1);
    //turn_Component(LOW_VALVE_OPEN);
    //sleep(TIME_FOR_LOW_VALVE_ON_IN_SECONDS);
    turn_Component(LOW_VALVE_SLEEP);
}

void turn_Component(unsigned char value){
  unsigned char data_received;
  OpenTransmission(MSP430_ADDRESS);
  if(write(i2c_fd,&value,1) < 0){
    printf("[ERROR] Error trying to write in i2c_fd.\n");
  }
  if(read(i2c_fd,&data_received,1) < 0){
    printf("[ERROR] Error trying to read in i2c_fd.\n");
  }
  else{
    //printf("Data Received: %d\n\n",data_received);
    if(data_received == TURN_BOMB_ON){
      printf("[LOG] Pump is on.\n");
    }
    else if(data_received == TURN_BOMB_OFF){
      printf("[LOG] Pump is off.\n");
    }
    else if(data_received == LOW_VALVE_OPEN){
      puts("[LOG] Low valve is opened.");
    }
    else if(data_received == LOW_VALVE_CLOSE){
      puts("[LOG] Low valve is closed.");
    }
    else if(data_received == LOW_VALVE_SLEEP){
      puts("[LOG] Low valve is sleeping.");
    }
    else if(data_received == TOP_VALVE_OPEN){
      puts("[LOG] Top valve is opened.");
    }
    else if(data_received == TOP_VALVE_CLOSE){
      puts("[LOG] Top valve is closed.");
    }
    else if(data_received == TOP_VALVE_SLEEP){
      puts("[LOG] Top valve is sleeping.");
    }
    else if(data_received == SAMPLES_MOTOR_ON){
      puts("[LOG] Samples Motor is ON.");
    }
    else if(data_received == SAMPLES_MOTOR_OFF){
      puts("[LOG] Samples Motor is OFF.");
    }
  }
  CloseTransmission();
}
